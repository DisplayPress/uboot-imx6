## board/info2go/amherst/Kconfig
```kconfig
if TARGET_AMHERST_QUAD

config SYS_BOARD
	default "amherst-quad"

config SYS_VENDOR
	default "info2go"

config SYS_SOC
	default "mx6"

config SYS_CONFIG_NAME
	default "amherst-quad"

endif
```

## configs/amherst-quad_defconfig
```kconfig
CONFIG_SYS_EXTRA_OPTIONS="IMX_CONFIG=board/info2go/amherst/mx6q_4x_mt41j128.cfg,MX6Q"
CONFIG_ARM=y
CONFIG_TARGET_AMHERST_QUAD=y
```
